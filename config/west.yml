## config/west.yml
```yaml
manifest:
  remotes:
    - name: zmkfirmware
      url-base: https://github.com/zmkfirmware
    - name: kwmlodozeniec
      url-base: https://github.com/kwmlodozeniec
  projects:
    - name: zmk
      remote: zmkfirmware
      revision: v0.3.0
      import: app/west.yml
    - name: zmk-usb-reporting
      remote: kwmlodozeniec
      revision: main
  self:
    path: config
```
