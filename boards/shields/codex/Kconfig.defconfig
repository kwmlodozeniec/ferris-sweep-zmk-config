## boards/shields/codex/Kconfig.defconfig
```kconfig
# Copyright (c) 2020 The ZMK Contributors
# SPDX-License-Identifier: MIT

if SHIELD_CODEX_DONGLE

config ZMK_KEYBOARD_NAME
    default "Codex Gigas DGL"

config ZMK_SPLIT_ROLE_CENTRAL
    default y

endif

if SHIELD_CODEX_LEFT || SHIELD_CODEX_RIGHT

config ZMK_SPLIT_ROLE_CENTRAL
    default n

endif

if SHIELD_CODEX_LEFT

config ZMK_KEYBOARD_NAME
    default "Codex Gigas"

endif

if SHIELD_CODEX_LEFT || SHIELD_CODEX_RIGHT || SHIELD_CODEX_DONGLE
config ZMK_SPLIT
    default y
endif
```

## boards/shields/codex/Kconfig.shield
```kconfig
# Copyright (c) 2020 The ZMK Contributors
# SPDX-License-Identifier: MIT

config SHIELD_CODEX_LEFT
    def_bool $(shields_list_contains,codex_left)

config SHIELD_CODEX_RIGHT
    def_bool $(shields_list_contains,codex_right)

config SHIELD_CODEX_DONGLE
    def_bool $(shields_list_contains,codex_dongle)
```
